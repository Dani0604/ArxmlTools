AUTOSAR XML (schema 00049)
standard types defined: uint8
package /DataTypes
  impl type Enum1: category=VALUE, base-type=uint8
  impl type Enum2: category=VALUE, base-type=uint8
package /DataTypes/ApplDataTypes
  app type Enum1: category=VALUE, sw-calibration-access=READ-WRITE, compu {0=Enum1_enum1, 1=Enum1_enum2, 2=Enum1_enum3}
  app type Enum2: category=VALUE, sw-calibration-access=READ-WRITE, compu {0=Enum2_enum1, 1=Enum2_enum2, 2=Enum2_enum3}
package /DataTypes/DataTypeMappings
  data type mapping set ComponentDataTypeMappingsSet: data-type-map{application-data-type=Enum1, implementation-data-type=Enum1}
  data type mapping set myDataTypeMappingSet
package /DataTypes/SwAddrMethods
  sw addr method CODE: section-type=CODE
  sw addr method CONST: section-type=CONST
  sw addr method VAR: section-type=VAR
package /DataTypes/Units
  unit NoUnit: factor-si-to-unit=1, offset-si-to-unit=0
package /myDataTypeMappingPackage
  data type mapping set myDataTypeMappingSet: data-type-map{application-data-type=Enum2, implementation-data-type=Enum2}
