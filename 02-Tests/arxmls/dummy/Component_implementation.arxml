AUTOSAR XML (schema 00049)
package /Components/SwcImplementations
  swc implementation Component_Impl: programming-language=C, sw-version=1.8.1, used-code-generator=Embedded Coder 7.9 (R2022b) 13-May-2022, vendor-id=0, behavior=Component_IB
    code-descriptors:
      code Code
        artifact-descriptors:
          short-label=Component_c, category=SWSRC
          short-label=Component_h, category=SWHDR
          short-label=Component_private_h, category=SWHDR
          short-label=Component_types_h, category=SWHDR
          short-label=rtwtypes_h, category=SWHDR
    resource consumption RsrcCons_Component
