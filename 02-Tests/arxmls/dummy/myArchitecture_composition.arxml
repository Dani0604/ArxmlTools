AUTOSAR XML (schema 00049)
package /Components
  composition sw component type untitled
    component Component: type=Component
    component Component1: type=Component1
