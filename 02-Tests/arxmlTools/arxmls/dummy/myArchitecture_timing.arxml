AUTOSAR XML (schema 00049)
package /Timing
  vfb timing untitled_timing: component=untitled
    timing-requirements:
      execution order constraint EOC: base-composition=untitled
        ordered-elements:
          eoc executable entity ref Component_Component_Step: component=Component, executable=Component_Step, successor=Component1_Component1_Step
          eoc executable entity ref Component1_Component1_Step: component=Component1, executable=Component1_Step
