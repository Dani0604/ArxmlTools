AUTOSAR XML (schema 00049)
package /Interfaces
  sender receiver interface interface1
    data a: category=VALUE, sw-calibration-access=READ-ONLY, type=Enum1
  sender receiver interface interface2
    data b: category=VALUE, sw-calibration-access=READ-ONLY, type=Enum2
